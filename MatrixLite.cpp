/***************************************************************************
 This is an EXTREMELY barebones class for Adafruit LED matrix backpacks.
 It's rude code that pulls shenanigans.  Some things to be aware of:

 - This is not extensively battle-tested, and surely contains bugs.
   Honestly, I'm not even sure if the I2C retries/timeout are canon.
 - This is not a subclass of Adafruit_GFX; NO drawing primitives are present
   (must use PROGMEM bitmaps, or construct bitmap in RAM), nor is rotation
   supported (bitmap pattern must accommodate physical layout).
 - Backpack esoterica like brightness, blink rate, etc. are not handled;
   always runs full brightness, blink disabled.  Very direct stuff.
 - This code bypasses the Arduino Wire library and handles I2C (TWI)
   communication directly -- it's ATmega-specific, nonportable, and does
   some crass things (e.g. 888 KHz TWI, fastest speed supported by this
   chip) -- don't even try using Wire library at the same time!  Only TWI
   master transmit is handled; other modes are not implemented.

 Why?

 - Reduced resource use, especially RAM.  The Wire library allocates a
   good chunk for read/write buffers, and Adafruit_GFX has a bitmap buffer
   for each matrix.  And core Arduino functionality seems to get a little
   more bloaty with each release.  Mostly this code's intended for use with
   the WaveHC library, which needs more than half the MCU's RAM for loading
   two SD card blocks at a time (plus various filesystem data) -- together
   with Wire and GFX, hard limits were being exceeded, sketches failing.
 - It uses polling rather than interrupts.  This might yield slightly better
   audio quality with WaveHC playback and/or the voice changer sketches.

 This is NOT officially-supported Adafruit code, just something Phil B.
 did goofing around on his own time. No warranty, no support, no expectation
 of eternal compatibility with future Arduino releases.  Use at own risk.
 ***************************************************************************/

#include "MatrixLite.h"

// Public functions:

// Constructor
MatrixLite::MatrixLite(uint8_t a) : addr(a << 1) {
  static boolean initialized = false;
  if(!initialized) {            // First matrix declaration?
    pinMode(SDA, INPUT_PULLUP); // Enable pullups
    pinMode(SCL, INPUT_PULLUP); // on I2C pins
    TWSR = 0; TWBR = 1;         // Max supported I2C speed (888 KHz)
    initialized = true;
  }
}

// Issue startup sequence to matrix before use
void MatrixLite::begin(void) {
  twiStart();
  for(uint8_t i=0; (i<17) && twiWrite(0); i++); // Clear matrix buffer
  twiStop();
  cmd(0x21); // Oscillator on
  cmd(0xEF); // Max brightness, no blink
  cmd(0x81); // Display on
}

// Issue single-byte command to matrix.  Allows access
// to brightness & blink features if really needed.  Ugh.
void MatrixLite::cmd(uint8_t n) {
  if(twiStart()) twiWrite(n);
  twiStop();
}

// These tables compensate for the physical order in which the LED matrix
// columns are wired, allowing the easy use of bitwise values to construct
// bitmap images -- e.g. so 0b00001111 lights the 4 right-most columns.
static const uint8_t PROGMEM
  reorder8[] = { // For 8x8 matrix, reverse bit order + ROR
   0x00,0x40,0x20,0x60,0x10,0x50,0x30,0x70,0x08,0x48,0x28,0x68,0x18,0x58,0x38,
   0x78,0x04,0x44,0x24,0x64,0x14,0x54,0x34,0x74,0x0c,0x4c,0x2c,0x6c,0x1c,0x5c,
   0x3c,0x7c,0x02,0x42,0x22,0x62,0x12,0x52,0x32,0x72,0x0a,0x4a,0x2a,0x6a,0x1a,
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   0xff },
  reorder16[] = { // For 16x8 matrix (or bicolor), reverse bit order (no ROR)
   0x00,0x80,0x40,0xc0,0x20,0xa0,0x60,0xe0,0x10,0x90,0x50,0xd0,0x30,0xb0,0x70,
   0xf0,0x08,0x88,0x48,0xc8,0x28,0xa8,0x68,0xe8,0x18,0x98,0x58,0xd8,0x38,0xb8,
   0x78,0xf8,0x04,0x84,0x44,0xc4,0x24,0xa4,0x64,0xe4,0x14,0x94,0x54,0xd4,0x34,
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   0x0f,0x8f,0x4f,0xcf,0x2f,0xaf,0x6f,0xef,0x1f,0x9f,0x5f,0xdf,0x3f,0xbf,0x7f,
   0xff };

// Random idea: might modify these functions to use raw TWI ops rather than
// calling Start/Write/Stop (see private functions later)...idea being to
// queue up next value in the idle time before polling TWI status, similar
// to SPI pipelining.  Low priority insane optimization; might shave a few
// microseconds/update at best, code would get very ugly with the retry
// loops & such.

// Update 8x8 matrix from bitmap in RAM
void MatrixLite::show(uint8_t *data) {
  if(twiStart()) {
    // Matrix driver expects write address followed by data (typically
    // zero followed by 16 bytes for the full display buffer).  8x8 matrix
    // only uses odd-numbered bytes; even bytes are ignored.  Little trick
    // here is to alternate eight 0's and eight data bytes -- the first 0
    // is interpreted as the start address, and then only 15 add'l bytes
    // are sent, last byte can be dropped since it's unused anyway.
    for(uint8_t i=0; twiWrite(0) &&
      twiWrite(pgm_read_byte(&reorder8[data[i++]])) && (i < 8); );
  }
  twiStop();
}

// Update 8x8 matrix from bitmap in PROGMEM
void MatrixLite::show(const uint8_t *data) {
  if(twiStart()) {
    for(uint8_t i=0; twiWrite(0) && twiWrite(
      pgm_read_byte(&reorder8[pgm_read_byte(&data[i++])])) && (i < 8); );
  }
  twiStop();
}

// Update 16x8 mono or 8x8 bicolor matrix from bitmap in RAM
void MatrixLite::show(uint16_t *data) {
  if(twiStart() && twiWrite(0)) {
    uint16_t n;
    for(uint8_t i=0; i<8; i++) {
      n = *data++;
      twiWrite(pgm_read_byte(&reorder16[n >> 8  ]));
      twiWrite(pgm_read_byte(&reorder16[n & 0xFF]));
    }
  }
  twiStop();
}

// Update 16x8 mono or 8x8 bicolor matrix from bitmap in PROGMEM
void MatrixLite::show(const uint16_t *data) {
  if(twiStart() && twiWrite(0)) {
    uint16_t n;
    for(uint8_t i=0; i<8; i++) {
      n = pgm_read_word(data++);
      twiWrite(pgm_read_byte(&reorder16[n >> 8  ]));
      twiWrite(pgm_read_byte(&reorder16[n & 0xFF]));
    }
  }
  twiStop();
}

// Private functions:

#define TWSR_MASK    0xF8 // TWI status register values
#define TWI_START    0x08
#define TWI_SLAW_ACK 0x18
#define TWI_DATA_ACK 0x28
#define TWI_RETRIES     4
#define TWI_TIMEOUT   200

// Begin TWI transmission; returns true on success, false otherwise
boolean MatrixLite::twiStart(void) {
  uint8_t r, t;

  for(r=0; r<TWI_RETRIES; r++) {
    TWCR = _BV(TWINT) | _BV(TWSTA) | _BV(TWEN);                // Send START,
    for(t=0; (!(TWCR & _BV(TWINT))) && (t++ < TWI_TIMEOUT); ); // Await flag
    if((TWSR & TWSR_MASK) == TWI_START) break;                 // START OK
  }

  if(r <= TWI_RETRIES) { // START OK
    for(uint8_t r=0; r<TWI_RETRIES; r++) {
      TWDR = addr;                   // TWI Address + write flag (0)
      TWCR = _BV(TWINT) | _BV(TWEN); // Transmit address
      for(t=0; (!(TWCR & _BV(TWINT))) && (t++ < TWI_TIMEOUT); );
      if((TWSR & TWSR_MASK) == TWI_SLAW_ACK) return true; // ACK (OK)
    }
  }

  return false; // FAIL, timeout or repeated NAKs
}

// Send byte over TWI (after Start); true on success, false otherwise
boolean MatrixLite::twiWrite(uint8_t n) {
  uint8_t r, t;
  for(r=0; r<TWI_RETRIES; r++) {
    TWDR = n;                      // Data to send
    TWCR = _BV(TWINT) | _BV(TWEN); // Start data transmission
    for(t=0; (!(TWCR & _BV(TWINT))) && (t++ < TWI_TIMEOUT); );
    if((TWSR & TWSR_MASK) == TWI_DATA_ACK) return true; // ACK (OK)
  }
  return false;                    // FAIL, repeated NAKs
}

// End TWI transmission (no return value)
void MatrixLite::twiStop(void) {
  TWCR = _BV(TWINT) | _BV(TWEN) | _BV(TWSTO); // Transmit STOP
  for(uint8_t t=0; (!(TWCR & _BV(TWINT))) && (t++ < TWI_TIMEOUT); );
}
